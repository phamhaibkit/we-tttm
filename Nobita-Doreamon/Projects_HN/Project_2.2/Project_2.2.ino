/*
  Chương trình đọc RFID từ RFID-RC522
  Cắm chân (Arduino Uno):
  SDA: Pin 10
  SCK: Pin 13
  MOSI: Pin 11
  MISO: Pin 12
  RST: Pin 9
*/

#include <SPI.h>
#include "RFID.h"
#include <U8glib.h>

#define SS_PIN 10
#define RST_PIN 9

int beepPin = 7;

RFID rfid(SS_PIN, RST_PIN);

int tag1[5] = {186 , 162, 171, 78, 253};
int tag2[5] = {181, 7, 83, 20, 245};
int newtag[5] = {0, 0, 0, 0, 0};



U8GLIB_SSD1306_128X64 u8g(U8G_I2C_OPT_NO_ACK);  // Display which does not send AC

const uint8_t xuka[] PROGMEM = {
  0x00, 0x00, 0x1F, 0xFC, 0x00, 0x00, 0x00, 0x00, 0xE0, 0x03, 0x80, 0x00, 0x00, 0x03, 0x00, 0x00,
  0xC0, 0x00, 0x00, 0x0C, 0x00, 0x00, 0x30, 0x00, 0x00, 0xF8, 0x00, 0x00, 0x18, 0x00, 0x03, 0x00,
  0x00, 0x00, 0x04, 0x00, 0x06, 0x00, 0x00, 0x00, 0x02, 0x00, 0x0C, 0x00, 0x00, 0x00, 0x01, 0x00,
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  0x00, 0x18, 0x04, 0x00, 0x00, 0xC2, 0x00, 0x10, 0x0C, 0x00, 0x00, 0xC2, 0x00, 0x10, 0x0C, 0x00
};

const uint8_t cake[] PROGMEM = {
  0x00, 0x00, 0x00, 0x10, 0x00, 0x00, 0x00, 0x00, 0x00, 0x00, 0x30, 0x00, 0x10, 0x00, 0x00, 0x00,
  0x00, 0x20, 0x00, 0x10, 0x00, 0x00, 0x00, 0x00, 0x68, 0x00, 0x30, 0x00, 0x00, 0x20, 0x00, 0x58,
  0x00, 0x38, 0x00, 0x00, 0x30, 0x00, 0xD8, 0x10, 0x78, 0x00, 0x00, 0x70, 0x08, 0xD0, 0x30, 0x6C,
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  0x30, 0x78, 0x31, 0x34, 0x2C, 0x20, 0x30, 0x78
};

const uint8_t empty[] PROGMEM = {
  0x00,
  0x00,
  0x00,
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  0x00,
  };
int ok = -1;

bool flag = false;
void setup()
{
  Serial.begin(9600);
  pinMode(beepPin,OUTPUT);
  digitalWrite(beepPin, LOW);
  
  SPI.begin();

  rfid.init();

  u8g.firstPage();
      do {
        u8g.drawBitmapP(2, 0, 1, 8, empty);
      } while ( u8g.nextPage() );

  while (flag == false) {
    readTags();
  }
}

void loop()
{

}

boolean compareTag(int aa[5], int bb[5])
{
  boolean ff = false;
  int fg = 0;
  for (int cc = 0 ; cc < 5 ; cc++)
  {
    if (aa[cc] == bb[cc])
    {
      fg++;
    }
  }
  if (fg == 5)
  {
    ff = true;
  }
  return ff;
}

void checkTags() // compares each tag against the tag just read
{
  ok = 0; // this variable helps decision-making,
  // if it is 1 we have a match, zero is a read but no match,
  // -1 is no read attempt made
  if (compareTag(newtag, tag1) == true)
  {
    ok++;
  }
  if (compareTag(newtag, tag2) == true)
  {
    ok++;
  }
}

void readTags()
{
  ok = -1;

  if (rfid.isCard()) {
    if (rfid.readCardSerial()) {
      for (int i = 0; i < 5; i++) {
        newtag[i] = rfid.serNum[i];
      }
    }
    for (int i = 0; i < 5; i++) {
      Serial.print(newtag[i]);
      Serial.println(",");
    }

    checkTags();
    delay(300);

    rfid.halt();

    // now do something based on tag type
    if (ok > 0) // if we had a match
    {
      Serial.println("Accepted");
      //      digitalWrite(beepPin, HIGH);
      digitalWrite(beepPin, HIGH);
      delay(1000);
      digitalWrite(beepPin, LOW);
      u8g.firstPage();
      do {
        u8g.drawBitmapP(2, 0, 7, 64, cake);
        u8g.drawBitmapP(75, 0, 6, 64, xuka);
      } while ( u8g.nextPage() );

      flag = true;

      ok = -1;
    }
    else if (ok == 0) // if we didn't have a match
    {
      Serial.println("Rejected");
      //      digitalWrite(no, LOW);
      //      delay(1000);
      //      digitalWrite(no, HIGH);

      ok = -1;
    }
  }
}
